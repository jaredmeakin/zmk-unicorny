## boards/shields/corne_dongle/Kconfig.defconfig
```kconfig
if SHIELD_CORNE_DONGLE

# Sets the keyboard name in Bluetooth
config ZMK_KEYBOARD_NAME
default "Corne Dongle"

# Tells ZMK this is a split keyboard
config ZMK_SPLIT
default y

# Tells ZMK this is the CENTRAL (brain) device
config ZMK_SPLIT_ROLE_CENTRAL
default y

endif
```
